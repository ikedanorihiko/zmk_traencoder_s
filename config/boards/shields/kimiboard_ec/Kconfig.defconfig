## config/boards/shields/kimiboard_ec/Kconfig.defconfig
```kconfig
if SHIELD_KIMIBOARD_EC

config ZMK_KEYBOARD_NAME
    default "KimiBoard EC"

# トラックボール(ポインティングデバイス)を有効化
config ZMK_POINTING
    default y

# ロータリーエンコーダーを有効化
config EC11
    default y

config EC11_TRIGGER_GLOBAL_THREAD
    default y

# SPI / GPIO入力サブシステム
config SPI
    default y

config INPUT
    default y

# PMW3610センサードライバ
config PMW3610
    default y

endif # SHIELD_KIMIBOARD_EC
```

## config/west.yml
```yaml
manifest:
  remotes:
    - name: zmkfirmware
      url-base: https://github.com/zmkfirmware
    - name: badjeff
      url-base: https://github.com/badjeff
  projects:
    - name: zmk
      remote: zmkfirmware
      revision: main
      import: app/west.yml
    # PMW3610トラックボールセンサー用ドライバ (KimiBoardと同系統のPMW3610を想定)
    - name: zmk-pmw3610-driver
      remote: badjeff
      revision: main
  self:
    path: config
```
